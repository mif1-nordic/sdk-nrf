## applications/sdp/mspi/sample.yaml
```yaml
sample:
  name: SDP mSPI application
  description: SDP mSPI application
common:
  integration_platforms:
    - nrf54l15dk/nrf54l15/cpuflpr
tests:
  applications.sdp.mspi.icmsg:
    build_only: true
    sysbuild: true
    platform_allow: nrf54l15dk/nrf54l15/cpuflpr
    tags: ci_build sysbuild mspi
    extra_configs:
      - CONFIG_IPC_SERVICE=y
      - CONFIG_IPC_SERVICE_BACKEND_ICMSG=y
```
