## drivers/saadct/Kconfig
```kconfig
#
# Copyright (c) 2026 Nordic Semiconductor
#
# SPDX-License-Identifier: LicenseRef-Nordic-5-Clause
#

DT_COMPAT_NORDIC_NRF_SAADCT := nordic,nrf-saadct

config SAADCT
	bool "SAADCT NRFX driver"
	select ADC
	select NRFX_TIMER
	select NRFX_GPPI
	select NRFX_SAADC
```

## dts/bindings/saadct/nordic,nrf-saadct.yaml
```yaml
# Copyright (c) 2018, Nordic Semiconductor ASA
# SPDX-License-Identifier: Apache-2.0

description: Nordic Semiconductor nRF family SAADCT node

compatible: "nordic,nrf-saadct"

include: nordic,nrf-saadc.yaml

properties:
  timer-instance:
    required: true
    type: phandle
    description: |
      Timer instance.
```
